## wmsdk_bundle-2.13.82/wmsdk-2.13.82/build/config/Kconfig
```kconfig
mainmenu "WMSDK build Configuration"

menu "System Type"
choice
	prompt "Platform Type"
	default CPU_MC200

config CPU_MC200
       bool "88MC200-based Platforms"
       select OS_FREERTOS
       select LWIP_STACK
       help
	 Select this option if you have a Marvell 88MC200 based Wireless
	 Micro-controller platform.

endchoice

choice
	prompt "Wi-Fi Chipset"
	default WLAN_878x

config WiFi_878x
	bool "878x-based Chipset"
	help
	  Select this option if you have a Marvell 878x-based 
	  Wireless chip. This option will enable support
	  for Marvell 878x-based wireless chips with
	  Wireless Micro-controller.

config WiFi_8801
       bool "8801-based Chipset"
       help
	 Select this option if you have a Marvell 8801 based Wireless
	 chip. This option will enable support for Marvell 8801 based
	 wireless chips with Wireless Micro-controller.

endchoice


# Choice of Operating System

config OS_FREERTOS
       bool
       help
	Selects the FreeRTOS operating system.


# Choice of Network Stacks

config LWIP_STACK
       bool
       help
        Selects the LWIP Network Stack

endmenu

source src/app_framework/Kconfig

menu "Modules"

source src/wlan/Kconfig
source src/middleware/mdns/Kconfig
source src/middleware/tls/Kconfig
source src/middleware/httpd/Kconfig
source src/middleware/json/Kconfig

menu "XZ Decompression"

config XZ_DECOMPRESSION
	bool "Enable XZ based decompression for WiFi firmware image"
	def_bool y
endmenu

menu "WiFi Firmware Upgrade Support"

config WIFI_FW_UPGRADE
	bool "Support for upgrade of WiFi firmware image"
	def_bool y
endmenu

endmenu

menu "Peripheral Drivers"

config MRVL_DRV_TUNL_DRIVER
       bool "Marvell Driver Tunneling Protocol support"
       def_bool y
       help
         This option enables Marvell Driver Tunneling
         Protocol. Say Y if you wish to use this chip.

config LCD_DRIVER
       bool "LCD Driver support"
       def_bool y
       help
	 This option enables support for the LCD driver NHD-C0216CiZ-FSW-FBW-3V3. Say Y if
         you with to use this driver.

config XFLASH_DRIVER
       bool "External Winbond W25Q32BV Serial Flash Driver support"
       def_bool y
       help
	 This option enables support for externally connected Winbond W25Q32BV Serial Flash.
	 The flash is connected to QSPI1. Say Y if you wish to use this driver.

config SPI_FLASH_DRIVER
       bool "External AT25L08 Serial Flash Driver support"
       def_bool n
       help
	This option enables support for externally connected AT25L08 flash.
	The flash is connected to SSP Port 1. Say Y if you wish to use this driver.

config USB_DRIVER
       bool "USB Driver support"
       def_bool n
       help
	 This option enables support for USB driver.
	 Say Y if you wish to use this driver.

config USB_DRIVER_HOST
       bool "USB Host Driver support"
       def_bool n
       help
	 This option enables support for USB Host driver.
	 Say Y if you wish to use this driver.
endmenu


menu "Miscellaneous"
config UART_RS485
       bool "Configures UART to be used for RS485 Communication"
       def_bool n
       help
	 This option enables hacks in UART driver for RS485 Communication.
         Note that Enabling this option uses GPIO8 as TX_ENABLE Signal for RS845 Transceiver.
	 Say Y here if UART is interfaced with RS485 Transceiver.

config UART_LARGE_RCV_BUF
       bool "Configures UART RCV Buffers of size 1024"
       def_bool n
       help
	 This option enables UART Rcv buffers of size 1024.
	 Say Y here if UART buffers of size 1024 are needed.

config SW_WATCHDOG
       bool "Software watchdog"
       def_bool n
       help
         This option enables software watchdog. Note that this is just a
	 simulation of watchdog behavior and may not work when system freezes

config HW_RTC
       bool "Hardware RTC"
       def_bool y
       help
         This option enables time-keeping using the RTC. Note that this may not
	 be accurate for internal un-calibrated RC32K clock.

endmenu

menu "Development and Debugging"

config ENABLE_ERROR_LOGS
       bool
       prompt "Enable error logs"
       default y
       help
		If you enable this, error messages
		will be printed in case of error
		conditions. This will increase the
		size of the image. It is strongly
		recommended to keep it enabled
		during development, to quickly
		localize problems.

config ENABLE_WARNING_LOGS
       bool
       prompt "Enable warning logs"
       default y
       help
		If you enable this, error messages
		will be printed in case of error
		conditions. This will increase the
		size of the image. It is strongly
		recommended to keep it enabled
		during development, to quickly
		localize problems.

config DEBUG_BUILD
       bool
       prompt  "Debug build"
       default y
       help
		If you enable this the debug options will be
      		 enabled. Asserts will be also be enabled.

config ENABLE_FREERTOS_RUNTIME_STATS_SUPPORT
       bool
       prompt "Enable FreeRTOS runtime stats support"
       default n
       help
		If you enable this FreeRTOS run time stats supporting
		functions will be enabled. Note that you will still need to
		enable FreeRTOS run time statistics from FreeRTOSConfig.h
		header file for this to work. Another point to note; his
		functionality will use a GPT for timing calculations. Please
		select free GPT from the menu provided. GPT0 is used by default.

if ENABLE_FREERTOS_RUNTIME_STATS_SUPPORT

choice
	prompt "Timer selection for runtime stats"
	default RUNTIME_STATS_USE_GPT0

config RUNTIME_STATS_USE_GPT0
       prompt "GPT0"
       bool
       help
		The choice of the timer to be used depends on the timers
		usage elsewhere for the system. The run time stats will
		require continuous use of the timer in the background
		and should be allocated a dedicated timer.

config RUNTIME_STATS_USE_GPT1
       prompt "GPT1"
       bool
       help
		The choice of the timer to be used depends on the timers
		usage elsewhere for the system. The run time stats will
		require continuous use of the timer in the background
		and should be allocated a dedicated timer.

config RUNTIME_STATS_USE_GPT2
       prompt "GPT2"
       bool
       help
		The choice of the timer to be used depends on the timers
		usage elsewhere for the system. The run time stats will
		require continuous use of the timer in the background
		and should be allocated a dedicated timer.

config RUNTIME_STATS_USE_GPT3
       prompt "GPT3"
       bool
       help
		The choice of the timer to be used depends on the timers
		usage elsewhere for the system. The run time stats will
		require continuous use of the timer in the background
		and should be allocated a dedicated timer.

endchoice

endif # ENABLE_FREERTOS_RUNTIME_STATS_SUPPORT

if DEBUG_BUILD
config ENABLE_ASSERTS
       bool "Enable ASSERTS"
       def_bool n
       help
		If you enable this various ASSERTS in the
		code will be enabled. This will help you
		find out various issues in the code. Very
		useful for debugging.

config DEBUG_OUTPUT
       bool "Enable Debugging Output"
       depends on DEBUG_BUILD
       def_bool y
       
config WLCMGR_DEBUG
       bool "Wireless Connection Manager"
       depends on DEBUG_OUTPUT
       def_bool n

config HEALTHMON_DEBUG
       bool "Health monitor"
       depends on DEBUG_OUTPUT
       def_bool n

config HTTPD_DEBUG
       bool "HTTP Web Server"
       depends on DEBUG_OUTPUT
       def_bool n

config TLS_DEBUG
       bool "Transport Layer Security"
       depends on DEBUG_OUTPUT
       depends on ENABLE_TLS
       def_bool n

config WIFI_DEBUG
       bool "Wireless Internals"
       depends on DEBUG_OUTPUT
       def_bool n


config PWR_DEBUG
       bool "Power Manager"
       depends on DEBUG_OUTPUT
       def_bool n

config WAKELOCK_DEBUG
       bool "Wake Locks"
       depends on DEBUG_OUTPUT
       def_bool n

config WPS_DEBUG
       bool "WiFi Protected Setup"
       depends on DEBUG_OUTPUT
       depends on WPS2
       def_bool n

config P2P_DEBUG
       bool "WiFi Direct (P2P)"
       depends on DEBUG_OUTPUT
       depends on P2P
       def_bool n

config DHCP_SERVER_DEBUG
       bool "DHCP Server"
       depends on DEBUG_OUTPUT
       def_bool n

config PROVISIONING_DEBUG
	bool "Provisioning"
	depends on DEBUG_OUTPUT
	def_bool n

config SUPPLICANT_DEBUG
	bool "Supplicant"
	depends on DEBUG_OUTPUT
	def_bool n

config HTTPC_DEBUG
       bool "HTTP Client"
       depends on DEBUG_OUTPUT
       def_bool n

config CRC_DEBUG
       bool "CRC"
       depends on DEBUG_OUTPUT
       def_bool n

config RFGET_DEBUG
       bool "rfget"
       depends on DEBUG_OUTPUT
       def_bool n

config CRYPTO_DEBUG
       bool "Cryptography"
       depends on DEBUG_OUTPUT
       def_bool n

config JSON_DEBUG
       bool "JSON"
       depends on DEBUG_OUTPUT
       def_bool n

config FLASH_DEBUG
       bool "Flash R/W"
       depends on DEBUG_OUTPUT
       def_bool n

config MDNS_DEBUG
        bool "mDNS"
		depends on DEBUG_OUTPUT
        def_bool n

config MDNS_CHECK_ARGS
		bool "mDNS: Check arguments for validity"
		depends on DEBUG_OUTPUT
		def_bool n

config APP_DEBUG
        bool "Application Framework"
		depends on DEBUG_OUTPUT
        def_bool n

config APP_FRAME_INTERNAL_DEBUG
	 bool "Application Framework (Internal)"
		depends on DEBUG_OUTPUT
        def_bool n

config LL_DEBUG
       bool "Low Level"
       depends on DEBUG_OUTPUT
       def_bool y
       help
       This option enables debug prints from low level
       drivers and OS code.

config OS_DEBUG
       bool "os Level"
       depends on LL_DEBUG
       def_bool n

config HEAP_DEBUG
       bool
       prompt "Heap debugger"
       default n
       help
		If you enable this dynamic memory use of API's alloc,
                 realloc, free will generate logs. These logs can be put 
		 through an external script to give memory leaks, max 
		 memory usage details. 

config PSM_DEBUG
	bool "psm"
	depends on DEBUG_OUTPUT
	def_bool n

config FTFS_DEBUG
	bool "ftfs"
	depends on DEBUG_OUTPUT
	def_bool n

config SEMAPHORE_DEBUG
	bool "Semaphore Debug"
	depends on DEBUG_OUTPUT
	def_bool n

config ENABLE_TESTS
       bool "Enable Test Setups"
       def_bool n

config HTTPD_TESTS
       bool "HTTP Web Server"
       depends on ENABLE_TESTS
       depends on HTTPD_CLI
       def_bool n

config JSON_TESTS
       bool "JSON"
       depends on ENABLE_TESTS
       def_bool n

config CLI_TESTS
       bool "Command Line Interface"
       depends on ENABLE_TESTS
       def_bool n

config SYSINFO_TESTS
       bool "Sysinfo"
       depends on ENABLE_TESTS
       def_bool n

config MDNS_TESTS
        bool "mDNS tests"
		depends on ENABLE_TESTS
        def_bool n

config EZXML_TESTS
        bool "ezxml tests"
		depends on ENABLE_TESTS
        def_bool n

config BA_TESTS
	bool "Block Allocator"
	depends on ENABLE_TESTS
	def_bool n

config MDEV_TESTS
	bool "MDEV Test Run"
	depends on ENABLE_TESTS
	def_bool n

config HEAP_TESTS
       bool
       prompt "Heap tests"
	depends on ENABLE_TESTS
       depends on OS_FREERTOS
       def_bool n

config AUTO_TEST_BUILD
       bool "Test Build Flag"
       def_bool n
       help
       This option enables some test APIs in firmware code.

endif # DEBUG_BUILD


endmenu
```

## wmsdk_bundle-2.13.82/wmsdk-2.13.82/src/app_framework/Kconfig
```kconfig
menu "Application Framework"


config APP_FRM_PROV_WPS
       bool "WPS Provisioning support"
       #delete by nzy 20150708
       #select WPS2 
       help
         This option enables the use of WPS in Provisioning in addition
	 to the provisioning network selected above.
	 Say Y if the application framework should also enable WPS in
	 provisioning mode.


endmenu
```

## wmsdk_bundle-2.13.82/wmsdk-2.13.82/src/middleware/httpd/Kconfig
```kconfig
menu "HTTP Server"
config ENABLE_HTTP
       prompt "Enable HTTP support (port 80)"
       bool
       default y

config ENABLE_HTTPS
       prompt "Enable HTTPS support (port 443)"
       bool
       depends on ENABLE_TLS
       default n
endmenu
```

## wmsdk_bundle-2.13.82/wmsdk-2.13.82/src/middleware/json/Kconfig
```kconfig
menu "JSON"
config JSON_FLOAT
       prompt "Enable Float support"
       bool
       default n
       help
       	    Selecting this enables support for float values in JSON
	    input/output. Selecting this pulls in float operation functions
	    that may result in footprint increase (~2KB).

endmenu
```

## wmsdk_bundle-2.13.82/wmsdk-2.13.82/src/middleware/mdns/Kconfig
```kconfig
menu "MDNS"

config MDNS_QUERY
        bool "mDNS Full-Fledged Query(monitoring) APIs"
        def_bool n
       help
       This option enables the support for querying mDNS-SD
       services. Enabling this option adds an overhead of about
       16KB. This includes support for caching two mDNS-SD service
       entries.

endmenu
```

## wmsdk_bundle-2.13.82/wmsdk-2.13.82/src/middleware/tls/Kconfig
```kconfig
menu "TLS"
config ENABLE_TLS
       prompt "Enable TLS library"
       bool
       default n
       depends on OS_FREERTOS && LWIP_STACK

if ENABLE_TLS
choice
	prompt "TLS library"
	default CYASSL

config CYASSL
       prompt "CyaSSL"
       bool

endchoice

endif

endmenu
```
